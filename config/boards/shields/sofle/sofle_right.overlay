/ {
    encoder_right: encoder_right {
        compatible = "alps,ec11";
        label = "ENCODER_RIGHT";
        a-gpios = <&gpio1 2 GPIO_ACTIVE_HIGH>;
        b-gpios = <&gpio1 1 GPIO_ACTIVE_HIGH>;
        resolution = <4>;
    };

    sensors {
        compatible = "zmk,sensors";
        sensors = <&encoder_right>;
    };
};
